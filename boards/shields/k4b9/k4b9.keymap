#include <behaviors.dtsi>
#include <dt-bindings/zmk/keys.h>
#include <dt-bindings/zmk/pointing.h>
#include <dt-bindings/zmk/bt.h>

/ {
    keymap {
        compatible = "zmk,keymap";

        default_layer {
            bindings = <
                &kp A   // L1
                &kp B   // L2
                &kp C   // 未実装L
                &kp D   // 未実装L

                &kp E   // L4
                &kp F   // L5
                &kp G   // 未実装L
                &kp H   // 未実装L

                &kp I   // 未実装R
                &kp J   // 未実装R
                &kp K   // R2
                &kp L   // R1

                &kp M   // 未実装R
                &kp N   // 未実装R
                &kp O   // R5
                &kp P   // R4

                &kp LEFT   // Left
                &bt BT_CLR      // Up
                &mkp LCLK   // X
                &mkp RCLK   // Y

                &mmv MOVE_Y(1000)   // Down
                &kp RIGHT   // Right
                &kp A   // A
                &kp B   // B

                &kp LA(TAB)   // FL
                &kp LS(LA(TAB))           // ZL
                &kp A           //ZR
                &kp B           //FR
            >;
            sensor-bindings = <&inc_dec_kp C_VOL_UP C_VOL_DN>;
        };
    };
};